## sdkconfig.defaults
```kconfig
# Override default sdkconfig to only use single core and slow 
# down cpu frequency from 240/160 mHz to 80 mHz

CONFIG_FREERTOS_UNICORE=y
CONFIG_ESP32_DEFAULT_CPU_FREQ_80=y
```
